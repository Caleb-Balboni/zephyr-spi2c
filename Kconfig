## dts/bindings/input/hn,spi2c.yaml
```yaml
description: HN spi to i2c communication protocol

compatible: "hn,spi2c"

include: base.yaml

properties:
  custom-devs:
    type: phandles
    required: true
    description: a list of all i2c devices this driver can interact with
  spi-dev:
    type: phandle
    required: true
    description: the slave spi device from which all communication will occur
  signal-gpios:
    type: phandle-array
    required: true
    description: the gpio used to signal the master that data is ready
```

## spi2c-driver/spi2c/Kconfig
```kconfig
config HN_SPI2C
	bool "spi transceiver for i2c communication"
	default n
	depends on SPI
	depends on SPI_SLAVE
	depends on !SPI_NXP_LPSPI_DMA
	depends on !SPI_ASYNC
	help
		enables the spi2c driver which automatically handles receiving and sending data from i2c devices
```
